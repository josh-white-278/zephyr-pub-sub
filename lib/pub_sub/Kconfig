## lib/pub_sub/Kconfig
```kconfig
menuconfig PUB_SUB
	bool "Publish Subscribe"
	select POLL
	help
	  Enables the publish subscribe messaging framework

if PUB_SUB

config PUB_SUB_DEFAULT_BROKER
	bool "Default pub/sub broker"
	default y

config PUB_SUB_RUNTIME_ALLOCATORS
	bool "Runtime allocators"

config PUB_SUB_RUNTIME_ALLOCATORS_MAX_NUM
	int "The maximum number of runtime pub/sub allocators"
	default 5
	depends on PUB_SUB_RUNTIME_ALLOCATORS

config PUB_SUB_EXPIRED_DELAYABLE_MSG_RETRY_TIME_MS
	int "How often to retry publishing expired delayable messages in milliseconds"
	default 5

endif
```

## tests/lib/hsm/hsm_subscriber/testcase.yaml
```yaml
# SPDX-License-Identifier: Apache-2.0

tests:
  lib.hsm.hsm_subscriber:
    tags: hsm
    integration_platforms:
      - native_sim
```

## tests/lib/pub_sub/runtime_subscriber/testcase.yaml
```yaml
# SPDX-License-Identifier: Apache-2.0

tests:
  lib.pub_sub.runtime_subscriber:
    tags: pub_sub
    integration_platforms:
      - native_sim
```

## west.yml
```yaml
manifest:
  remotes:
    - name: zephyrproject-rtos
      url-base: https://github.com/zephyrproject-rtos

  projects:
    - name: zephyr
      remote: zephyrproject-rtos
      revision: ae0ad38
      import:
        name-allowlist:
          - cmsis
          - hal_nordic
      west-commands: scripts/west-commands.yml
```
