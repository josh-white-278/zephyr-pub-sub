## lib/hsm/Kconfig
```kconfig
menuconfig HSM
	bool "Hierarchical State Machine"
	select PUB_SUB
	help
	  Enables the hierarchical state machine framework

if HSM

config HSM_MAX_NESTED_STATES
    int "The maximum number of nested states"
    default 8

endif
```

## tests/lib/hsm/basic/testcase.yaml
```yaml
# SPDX-License-Identifier: Apache-2.0

tests:
  lib.hsm.basic:
    tags: hsm
    integration_platforms:
      - native_sim
```

## tests/lib/pub_sub/alloc_mem_slab/testcase.yaml
```yaml
# SPDX-License-Identifier: Apache-2.0

tests:
  lib.pub_sub.alloc_mem_slab:
    tags: pub_sub
    integration_platforms:
      - native_sim
```

## tests/lib/pub_sub/static_msg/testcase.yaml
```yaml
# SPDX-License-Identifier: Apache-2.0

tests:
  lib.pub_sub.static_msg:
    tags: pub_sub
    integration_platforms:
      - native_sim
```

## tests/lib/pub_sub/sub_fifo/testcase.yaml
```yaml
# SPDX-License-Identifier: Apache-2.0

tests:
  lib.pub_sub.sub_fifo:
    tags: pub_sub
    integration_platforms:
      - native_sim
```

## tests/lib/pub_sub/sub_msgq/testcase.yaml
```yaml
# SPDX-License-Identifier: Apache-2.0

tests:
  lib.pub_sub.sub_msgq:
    tags: pub_sub
    integration_platforms:
      - native_sim
```
