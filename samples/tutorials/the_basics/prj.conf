## CMakeLists.txt
```
cmake_minimum_required(VERSION 3.20.0)
find_package(Zephyr REQUIRED HINTS $ENV{ZEPHYR_BASE})
project(the_basics)

target_sources(app PRIVATE
    src/main.c
    src/button.c
    src/led.c
)
```

## sample.yaml
```
sample:
  name: Tutorial - The Basics
tests:
  samples.tutorials.the_basics:
    tags: pub_sub
    integration_platforms:
      - nrf52840dongle_nrf52840
```

## prj.conf
```kconfig
CONFIG_PUB_SUB=y
CONFIG_GPIO=y
CONFIG_LOG=y
```

## src/main.c
```c
#include <zephyr/kernel.h>
#include <zephyr/logging/log.h>

LOG_MODULE_REGISTER(main);

int main(void)
{
	LOG_INF("Tutorial - The Basics");
	while (1) {
		k_sleep(K_SECONDS(10));
	}
	return 0;
}
```

## src/button.c
```c
#include <pub_sub/pub_sub.h>
#include <pub_sub/msg_alloc_mem_slab.h>
#include <zephyr/device.h>
#include <zephyr/drivers/gpio.h>
#include <zephyr/kernel.h>
#include <zephyr/logging/log.h>
#include "public_msgs.h"

LOG_MODULE_REGISTER(button);

#define SW0_NODE DT_ALIAS(sw0)
#if !DT_NODE_HAS_STATUS(SW0_NODE, okay)
#error "Unsupported board: sw0 devicetree alias is not defined"
#endif

static const struct gpio_dt_spec g_button = GPIO_DT_SPEC_GET(SW0_NODE, gpios);
static struct gpio_callback g_button_cb_data;
PUB_SUB_MEM_SLAB_ALLOCATOR_DEFINE_STATIC(g_msg_alloc, sizeof(struct button_state_msg), 4);

static void button_callback(const struct device *dev, struct gpio_callback *cb, uint32_t pins)
{
	int state = gpio_pin_get_dt(&g_button);
	LOG_INF("Button state: %d", state);
	struct button_state_msg *msg = pub_sub_new_msg(&g_msg_alloc, PUB_MSG_ID_BUTTON_STATE,
						       sizeof(struct button_state_msg), K_NO_WAIT);
	if (msg != NULL) {
		// state == 1 button pressed
		// state == 0 button not pressed
		msg->button_is_down = state == 1;
		pub_sub_publish(msg);
	} else {
		LOG_ERR("NULL msg");
	}
}

static int init_button(void)
{
	if (!gpio_is_ready_dt(&g_button)) {
		LOG_ERR("Button not ready");
		return 0;
	}

	int ret = gpio_pin_configure_dt(&g_button, GPIO_INPUT);
	if (ret != 0) {
		LOG_ERR("Button failed to configure: %d", ret);
		return 0;
	}

	ret = gpio_pin_interrupt_configure_dt(&g_button, GPIO_INT_EDGE_BOTH);
	if (ret != 0) {
		LOG_ERR("Button failed to configure interrupt: %d", ret);
		return 0;
	}

	gpio_init_callback(&g_button_cb_data, button_callback, BIT(g_button.pin));
	ret = gpio_add_callback(g_button.port, &g_button_cb_data);
	if (ret != 0) {
		LOG_ERR("Button failed to add callback to interrupt: %d", ret);
		return 0;
	}
	return 0;
}

SYS_INIT(init_button, APPLICATION, 0);
```

## src/led.c
```c
#include <pub_sub/pub_sub.h>
#include <zephyr/logging/log.h>
#include <zephyr/device.h>
#include <zephyr/drivers/led.h>
#include "public_msgs.h"

LOG_MODULE_REGISTER(led);

#define LED_PWM_NODE_ID   DT_PATH(pwmleds)
#define GREEN_LED_NODE_ID DT_NODELABEL(green_pwm_led)
#define GREEN_LED_CHANNEL DT_PHA_BY_IDX(GREEN_LED_NODE_ID, pwms, 0, channel)

#if !DT_NODE_HAS_STATUS(LED_PWM_NODE_ID, okay)
#error "Unsupported board: pwmleds devicetree node is not defined"
#endif

#if !DT_NODE_HAS_STATUS(GREEN_LED_NODE_ID, okay)
#error "Unsupported board: green_pwm_led devicetree node is not defined"
#endif

struct led_subscriber {
	PUB_SUB_ADD_SUBSCRIBER_CMPNT(PUB_MSG_ID_MAX_ID);
	const struct device *pwm_leds;
};

static void led_msg_handler(struct pub_sub_subscriber *subscriber, uint16_t msg_id,
			    const void *msg);

static struct led_subscriber g_led0_subscriber = {
	PUB_SUB_INIT_SUBSCRIBER_CMPNT(g_led0_subscriber, &k_sys_work_q, led_msg_handler,
				      PUB_MSG_ID_MAX_ID),
	.pwm_leds = DEVICE_DT_GET(LED_PWM_NODE_ID),
};
PUB_SUB_SUBSCRIBER_ADD(PUB_SUB_SUBSCRIBER_CMPNT(&g_led0_subscriber), 0);

static void led_msg_handler(struct pub_sub_subscriber *subscriber, uint16_t msg_id, const void *msg)
{
	struct led_subscriber *led_sub =
		PUB_SUB_CONTAINER_FROM_SUBSCRIBER(subscriber, struct led_subscriber);
	switch (msg_id) {
	case PUB_MSG_ID_BUTTON_STATE: {
		const struct button_state_msg *button_state_msg = msg;
		if (button_state_msg->button_is_down) {
			led_on(led_sub->pwm_leds, GREEN_LED_CHANNEL);
			LOG_INF("LED on");
		} else {
			led_off(led_sub->pwm_leds, GREEN_LED_CHANNEL);
			LOG_INF("LED off");
		}
		return;
	}
	}
}

static int init_led(void)
{
	pub_sub_subscribe(PUB_SUB_SUBSCRIBER_CMPNT(&g_led0_subscriber), PUB_MSG_ID_BUTTON_STATE);
	return 0;
}

SYS_INIT(init_led, APPLICATION, 0);
```

## src/public_msgs.h
```c
#ifndef PUBLIC_MSGS_H_
#define PUBLIC_MSGS_H_

#ifdef __cplusplus
extern "C" {
#endif

enum pub_msg_id {
	PUB_MSG_ID_BUTTON_STATE,
	PUB_MSG_ID_MAX_ID = PUB_MSG_ID_BUTTON_STATE,
};

// PUB_MSG_ID_BUTTON_STATE
struct button_state_msg {
	bool button_is_down;
};

#ifdef __cplusplus
}
#endif

#endif /* PUBLIC_MSGS_H_ */
```
